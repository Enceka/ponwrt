#include "an7581-fiberhome-hg5585f-ct.dts"

&{/reserved-memory} {
	npu_ba_7916: npu-ba@92980000 {
		reg = <0 0x92980000 0 0x80000>;
		no-map;
	};
	npu_pkt_7916: npu-pkt@92a00000 {
		reg = <0 0x92a00000 0 0x600000>;
		no-map;
	};
};

&npu {
	firmware-name = "airoha/hg5585f-ct/npu_rv32.bin",
			"airoha/hg5585f-ct/npu_data.bin";
	memory-region = <&npu_binary>, <&npu_ba_7916>, <&npu_pkt_7916>;
	memory-region-names = "binary", "ba", "connac2-pkt";
};
